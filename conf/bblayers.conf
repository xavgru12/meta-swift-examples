## conf/bblayers.conf
```bitbake
# POKY_BBLAYERS_CONF_VERSION is increased each time build/conf/bblayers.conf
# changes incompatibly
POKY_BBLAYERS_CONF_VERSION = "2"

BBPATH = "${TOPDIR}"
REPOROOT := "${@os.path.abspath(d.getVar('FILE') + '/../../..')}"

BBFILES += "${REPOROOT}/meta-swift-overrides/*.bbappend"

BBLAYERS ?= " \
  ${REPOROOT}/poky/meta \
  ${REPOROOT}/poky/meta-poky \
  ${REPOROOT}/poky/meta-yocto-bsp \
  ${REPOROOT}/meta-swift \
  "
```

## conf/local.conf
```bitbake
# Swift for Yocto
MACHINE="qemuarm"
IMAGE_FEATURES += "debug-tweaks"
IMAGE_INSTALL:append = " swift-hello-world"
```
